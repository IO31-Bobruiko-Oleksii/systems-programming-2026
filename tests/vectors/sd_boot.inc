/* GENERATED by scripts/vcd_tool.py vectors; do not edit.
 * Source: boot.vcd, sha256 b85b45fdbcce7a7aaac67f37233326612bd85ba471085c8fa4f5b6bc1ea6cbf9
 * 587 SPI bytes in time order, decoded as SPI mode 0 from SCK D0, MOSI D1, MISO D2, CS D3.
 * FLAGS bit0 = CS asserted (low) while the byte was clocked, bit1 = fast clock (6 MHz, SCK period < 1 us). */
#define SD_BOOT_LEN 587U
static const uint8_t SD_BOOT_MOSI[SD_BOOT_LEN] = {
    0xFF, 0xFF, 0xFF, 0xFF, 0xFF, 0xFF, 0xFF, 0xFF, 0xFF, 0xFF, 0x40, 0x00, 0x00, 0x00, 0x00, 0x95,
    0xFF, 0xFF, 0x48, 0x00, 0x00, 0x01, 0xAA, 0x87, 0xFF, 0xFF, 0xFF, 0xFF, 0xFF, 0xFF, 0x77, 0x00,
    0x00, 0x00, 0x00, 0x01, 0xFF, 0xFF, 0x69, 0x40, 0x00, 0x00, 0x00, 0x01, 0xFF, 0xFF, 0x7A, 0x00,
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    0xFF, 0xFF, 0xFF, 0xFF, 0xFF, 0xFF, 0xFF, 0xFF, 0xFF, 0xFF, 0xFF,
};
static const uint8_t SD_BOOT_MISO[SD_BOOT_LEN] = {
    0xFF, 0xFF, 0xFF, 0xFF, 0xFF, 0xFF, 0xFF, 0xFF, 0xFF, 0xFF, 0x00, 0xFF, 0xFF, 0xFF, 0xFF, 0xFF,
    0xFF, 0x01, 0xFF, 0xFF, 0xFF, 0xFF, 0xFF, 0xFF, 0xFF, 0x01, 0x00, 0x00, 0x01, 0xAA, 0xFF, 0xFF,
    0xFF, 0xFF, 0xFF, 0xFF, 0xFF, 0x01, 0xFF, 0xFF, 0xFF, 0xFF, 0xFF, 0xFF, 0xFF, 0x00, 0xFF, 0xFF,
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    0x00, 0x00, 0x00, 0x00, 0x00, 0x00, 0x55, 0xAA, 0xB0, 0x62, 0xFF,
};
static const uint8_t SD_BOOT_FLAGS[SD_BOOT_LEN] = {
    0x00, 0x00, 0x00, 0x00, 0x00, 0x00, 0x00, 0x00, 0x00, 0x00, 0x01, 0x01, 0x01, 0x01, 0x01, 0x01,
    0x01, 0x01, 0x01, 0x01, 0x01, 0x01, 0x01, 0x01, 0x01, 0x01, 0x01, 0x01, 0x01, 0x01, 0x01, 0x01,
    0x01, 0x01, 0x01, 0x01, 0x01, 0x01, 0x01, 0x01, 0x01, 0x01, 0x01, 0x01, 0x01, 0x01, 0x01, 0x01,
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    0x03, 0x03, 0x03, 0x03, 0x03, 0x03, 0x03, 0x03, 0x03, 0x03, 0x02,
};
