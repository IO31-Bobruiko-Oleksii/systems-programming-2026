/* GENERATED by scripts/vcd_tool.py vectors; do not edit.
 * Source: nosd.vcd, sha256 6722874b3bf476c58a406ca3e69c4800e4002f77142fb3df9a41625207a4e2de
 * 46 SPI bytes in time order, decoded as SPI mode 0 from SCK D0, MOSI D1, MISO D2, CS D3.
 * FLAGS bit0 = CS asserted (low) while the byte was clocked, bit1 = fast clock (6 MHz, SCK period < 1 us). */
#define SD_NOSD_LEN 46U
static const uint8_t SD_NOSD_MOSI[SD_NOSD_LEN] = {
    0xFF, 0xFF, 0xFF, 0xFF, 0xFF, 0xFF, 0xFF, 0xFF, 0xFF, 0xFF, 0x40, 0x00, 0x00, 0x00, 0x00, 0x95,
    0xFF, 0x40, 0x00, 0x00, 0x00, 0x00, 0x95, 0xFF, 0x40, 0x00, 0x00, 0x00, 0x00, 0x95, 0xFF, 0x40,
    0x00, 0x00, 0x00, 0x00, 0x95, 0xFF, 0x40, 0x00, 0x00, 0x00, 0x00, 0x95, 0xFF, 0xFF,
};
static const uint8_t SD_NOSD_MISO[SD_NOSD_LEN] = {
    0x00, 0x00, 0x00, 0x00, 0x00, 0x00, 0x00, 0x00, 0x00, 0x00, 0x00, 0x00, 0x00, 0x00, 0x00, 0x00,
    0x00, 0x00, 0x00, 0x00, 0x00, 0x00, 0x00, 0x00, 0x00, 0x00, 0x00, 0x00, 0x00, 0x00, 0x00, 0x00,
    0x00, 0x00, 0x00, 0x00, 0x00, 0x00, 0x00, 0x00, 0x00, 0x00, 0x00, 0x00, 0x00, 0x00,
};
static const uint8_t SD_NOSD_FLAGS[SD_NOSD_LEN] = {
    0x00, 0x00, 0x00, 0x00, 0x00, 0x00, 0x00, 0x00, 0x00, 0x00, 0x01, 0x01, 0x01, 0x01, 0x01, 0x01,
    0x01, 0x01, 0x01, 0x01, 0x01, 0x01, 0x01, 0x01, 0x01, 0x01, 0x01, 0x01, 0x01, 0x01, 0x01, 0x01,
    0x01, 0x01, 0x01, 0x01, 0x01, 0x01, 0x01, 0x01, 0x01, 0x01, 0x01, 0x01, 0x01, 0x00,
};
